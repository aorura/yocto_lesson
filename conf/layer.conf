## conf/layer.conf
```bitbake
# We have a conf and classes directory, add to BBPATH
BBPATH .= ":${LAYERDIR}"

# We have recipes-* directories, add to BBFILES
BBFILES += "${LAYERDIR}/recipes-*/*/*.bb \
            ${LAYERDIR}/recipes-*/*/*.bbappend"

BBFILE_COLLECTIONS += "emptytest"
BBFILE_PATTERN_emptytest = "^${LAYERDIR}/"
BBFILE_PRIORITY_emptytest = "6"

#BBMASK += "/home/yoctouser/poky/emptytest/recipes-hello/cmake-libhello/cmake-libhello.bb"
```
